## kernel-veyron.its
```
/dts-v1/;
 
/ {
    description = "Chrome OS kernel image with one or more FDT blobs";
    images {
        kernel@1{
            description = "kernel";
            data = /incbin/("vmlinuz-4.8.0-2-armmp");
            type = "kernel_noload";
            arch = "arm";
            os = "linux";
            compression = "none";
            hash@1{
                algo = "sha1";
            };
        };
        fdt@1{
            description = "rk3288-veyron-speedy.dtb";
            data = /incbin/("rk3288-veyron-speedy.dtb");
            type = "flat_dt";
            arch = "arm";
            compression = "none";
            hash@1{
                algo = "sha1";
            };
        };
        ramdisk@1{
            description = "ramdisk_image";
            data = /incbin/("initrd.img-4.8.0-2-armmp");
            type = "ramdisk";
            arch = "arm";
            os = "linux";
            compression = "gzip";
            hash@1{
                algo = "sha1";
            };
        };
    };

    configurations {
        default = "conf@1";
        conf@1{
            kernel = "kernel@1";
            fdt = "fdt@1";
	    ramdisk = "ramdisk@1";
        };
    };
};
```
